VERSION ""

NS_ :

BS_:

BU_:

BO_ 160 ENGINE_RPM: 8 ECU_Engine
 SG_ EngineRPM : 7|16@0+ (1,0) [0|0] "rpm" Vector__XXX

BO_ 161 ENGINE_TEMP: 8 ECU_Engine
 SG_ EngineTemp : 7|16@0- (0.1,0) [0|0] "degC" Vector__XXX

BO_ 176 BRAKE_PRESS: 8 ECU_Brake
 SG_ BrakePressure : 7|16@0+ (0.01,0) [0|0] "bar" Vector__XXX

BO_ 177 BRAKE_STATUS: 8 ECU_Brake
 SG_ BrakeStatus : 7|8@0+ (1,0) [0|0] "" Vector__XXX

BO_ 192 GATEWAY_FWD: 8 ECU_Gateway
 SG_ FwdRPM : 7|16@0+ (1,0) [0|0] "rpm" Vector__XXX
